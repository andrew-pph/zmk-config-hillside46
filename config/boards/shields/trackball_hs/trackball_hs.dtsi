/*
 * Copyright (c) 2021-2022 The ZMK Contributors
 *
 * SPDX-License-Identifier: MIT
 */

#include <dt-bindings/zmk/matrix_transform.h>
#include <input/processors.dtsi>

/ {
    chosen {
        zmk,kscan = &kscan0;
        zmk,matrix_transform = &default_transform;
    };

    default_transform: keymap_transform_0 {
        compatible = "zmk,matrix-transform";
        columns = <2>;
        rows = <2>;
        map = <
			RC(0,1)
		RC(0,0) RC(0,2)
        >;
    };

    kscan0: kscan {
	    label = "KSCAN";
    };
};
