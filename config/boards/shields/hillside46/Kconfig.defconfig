## config/boards/shields/hillside46/Kconfig.defconfig
```kconfig
# Copyright (c) 2021-2022 The ZMK Contributors
# SPDX-License-Identifier: MIT

if SHIELD_HILLSIDE46_LEFT

config ZMK_KEYBOARD_NAME
    default "Hillside46"

config ZMK_SPLIT_BLE_ROLE_CENTRAL
    default y

endif

if SHIELD_HILLSIDE46_LEFT || SHIELD_HILLSIDE46_RIGHT || SHIELD_HILLSIDE46_TRACKBALL

config ZMK_SPLIT
    default y

endif
```

## config/boards/shields/trackball_hs/Kconfig.shield
```kconfig
# Copyright (c) 2021-2022 The ZMK Contributors
# SPDX-License-Identifier: MIT

config SHIELD_TRACKBALL_HS
    def_bool $(shields_list_contains,trackball_hs)
```
